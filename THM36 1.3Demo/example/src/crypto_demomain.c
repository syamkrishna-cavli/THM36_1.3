/********************************************************************************
* Copyright (c) 2023, Tongxin Microelectroics Co., Ltd. 
* All rights reserved. 
* Module: crypto_demomain.c
* Version: V1.0 
* History: 
*   2023-05-22 Original version 
*********************************************************************************/ 

/* Includes ------------------------------------------------------------------*/
#include "thm36_1.3.h"
#include "flash_demomain.h"
#include "tmcECCEncDecPtchk.h"
#include "printfunc.h"
#include "AES_CFB.h"

/*- Data convert ------------------------------------------------------------------*/

/* Private variables ---------------------------------------------------------*/
__align(4) unsigned char gCryptoResultBuff[0x200];
__align(4) unsigned char gPlainDataBuff[0x200];
/* Private functions ---------------------------------------------------------*/
#define tmcGetRandomNum				pkeGetRandomNum

#define AES_MODE_128_KEY_DECRYPT   0xA5
#define AES_MODE_128_KEY_ENCRYPT   0xAA
#define AES_MODE_192_KEY_DECRYPT   0x55
#define AES_MODE_192_KEY_ENCRYPT   0x5A
#define AES_MODE_256_KEY_DECRYPT   0x35
#define AES_MODE_256_KEY_ENCRYPT   0x3A

#define AES_CRYPT_DATA_LEN	0x10


#define XDES_MODE_KEY_DECRYPT	0xA5
#define XDES_MODE_KEY_ENCRYPT	0xAA
#define XDES_MODE_2KEY_DECRYPT   0x55
#define XDES_MODE_2KEY_ENCRYPT   0x5A
#define XDES_MODE_3KEY_DECRYPT   0x35
#define XDES_MODE_3KEY_ENCRYPT   0x3A


#define XDES_CRYPT_DATA_LEN	  0x08

#define PKE_ALG_OK		  ((uint16_t)0xAAAA)
#define PKE_ALG_ERROR	   ((uint16_t)0x5555)

#define RSA_GEN_KEY_MODE_VERIFY				(1<<2)
#define RSA_GEN_KEY_MODE_MSB_BIT_1			0x02
#define RSA_GEN_KEY_MODE_MSB_BITS_11		0x03 

#define ECC_GEN_KEY_MODE_INPTUT_PRI_KEY		0x00 
#define ECC_GEN_KEY_MODE_GEN_PRI_KEY		0x01 

/************************** AES_ECB Encrypt & Decrypt **********************/
/* ECB data */
__align(4) const unsigned char AES128bKey[16]	   = {0x53, 0x6C, 0x33, 0x85, 0xC7, 0x43, 0xD7, 0x45, 0x8C, 0xA6, 0x4D, 0xE9, 0xC1, 0xB1, 0x23, 0xA7};
__align(4) const unsigned char AES128bPlainData[16] = {0x96, 0x8F, 0x3D, 0x75, 0x4B, 0xE0, 0x82, 0x4A, 0x04, 0x94, 0xF8, 0x97, 0x08, 0x87, 0x1D, 0x3F};
__align(4) const unsigned char AES128bEncData[16]   = {0x05, 0xDA, 0x99, 0x80, 0x99, 0x18, 0xEC, 0x0E, 0xDF, 0x46, 0xEB, 0xAC, 0xDF, 0x13, 0x99, 0xE3};

__align(4) const unsigned char AES192bKey[24]	   = {0xEA, 0xCF, 0x55, 0x22, 0xC1, 0xCD, 0x35, 0x1B, 0x7A, 0xD2, 0x99, 0x7C, 0x78, 0x28, 0x4D, 0x3D, 0xBB, 0xB6, 0x33, 0x18, 0x54, 0x56, 0x7B, 0xA2};
__align(4) const unsigned char AES192bPlainData[16] = {0x89, 0xBC, 0xDE, 0xFF, 0xED, 0xCB, 0xA9, 0x87, 0xFE, 0xA9, 0x87, 0x89, 0xBC, 0xDC, 0xBD, 0xEF};
__align(4) const unsigned char AES192bEncData[16]   = {0xE0, 0xB7, 0x9B, 0x19, 0x9E, 0x1C, 0x60, 0xB6, 0xAD, 0x3E, 0xB1, 0x3F, 0xAD, 0x1C, 0x7E, 0xFF};

__align(4) const unsigned char AES256bKey[32]	   = {0x00, 0x01, 0x02, 0x03, 0x04, 0x05, 0x06, 0x07, 0x08, 0x09, 0x0A, 0x0B, 0x0C, 0x0D, 0x0E, 0x0F, 0x10, 0x11, 0x12, 0x13, 0x14, 0x15, 0x16, 0x17, 0x18, 0x19, 0x1A, 0x1B, 0x1C, 0x1D, 0x1E, 0x1F};
__align(4) const unsigned char AES256bPlainData[16] = {0x00, 0x11, 0x22, 0x33, 0x44, 0x55, 0x66, 0x77, 0x88, 0x99, 0xAA, 0xBB, 0xCC, 0xDD, 0xEE, 0xFF};
__align(4) const unsigned char AES256bEncData[16]   = {0x8E, 0xA2, 0xB7, 0xCA, 0x51, 0x67, 0x45, 0xBF, 0xEA, 0xFC, 0x49, 0x90, 0x4B, 0x49, 0x60, 0x89};

__align(4) const unsigned char AES_IV[16]	   	   = {0x53, 0x6C, 0x33, 0x85, 0xC7, 0x43, 0xD7, 0x45, 0x8C, 0xA6, 0x4D, 0xE9, 0xC1, 0xB1, 0x23, 0xA7};


//0x00 ~ 0xFF AES128 encrypt output data
__align(4) const unsigned char AES128_0_ENCRYPT[256] = 
{
	0x5B,  0xDC,  0x80,  0xC4,  0xF0,  0x6C,  0x9D,  0x4C,  0xCC,  0xC8,  
	0xE7,  0x0D,  0x5D,  0xEA,  0x43,  0xC2,  0x01,  0xA8,  0x93,  0x51,  
	0x48,  0x99,  0xC3,  0x9D,  0xBB,  0x0D,  0xD2,  0x60,  0x24,  0x21,  
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	0x37,  0xB0,  0x4A,  0x62,  0x2B,  0x52
};
//0x00 ~ 0xFF AES192 encrypt output data
__align(4) const unsigned char AES192_0_ENCRYPT[256] = 
{
	0x76,  0xB8,  0x51,  0x2E,  0x93,  0xE6,  0xB1,  0x0C,  0xFD,  0xFB,  
	0x7E,  0x35,  0x22,  0x40,  0xF3,  0x02,  0x36,  0x8F,  0x89,  0x13,  
	0xF0,  0x19,  0xE8,  0x53,  0x56,  0x5D,  0x5B,  0x7C,  0xDF,  0xDA,  
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	0x15,  0xDF,  0x1D,  0xC9,  0xD8,  0xA7
};
//0x00 ~ 0xFF AES256 encrypt output data
__align(4) const unsigned char AES256_0_ENCRYPT[256] = 
{
	0x39,  0x48,  0x6E,  0xC6,  0x02,  0xC1,  0xAC,  0xE8,  0x5D,  0x5C,  
	0xCA,  0x65,  0x91,  0x35,  0x0C,  0x68,  0x18,  0xD1,  0xC0,  0x84,  
	0x9B,  0x2B,  0x25,  0x76,  0x1C,  0x7C,  0x92,  0xE2,  0x62,  0xD9,  
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	0xF0,  0x9D,  0xE8,  0xE1,  0x65,  0x96
};

/**
    * @brief AES_CFB_Demo_Test:
                1.Encryption in 128-bit CFB mode
                2.Decryption in 128-bit CFB mode
                3.Encryption in 192-bit CFB mode
                4.Decryption in 192-bit CFB mode
                5.Encryption in 256-bit CFB mode
                6.Decryption in 256-bit CFB mode
    * @param  None
    * @retval None
 */
void AES_CFB_Demo_Test(void)
{
	uint16_t resAES;
	uint8_t randomLen;
	do{
		tmcGetRandomNum(&randomLen, 1);		//	1 byte random length, <256
	}while(randomLen == 0);		//	must  >0

	// memset(gPlainDataBuff, 0x00, randomLen);
	UART_printf("AES test len = %d\r\n", randomLen);
	UART_printf("The plaintext is:\r\n");
	for(uint32_t i=0; i < randomLen; i++)
	{
		gPlainDataBuff[i] = i;		// 0x00 ~ randomLen-1
		UART_printf("%02X ", gPlainDataBuff[i]);
	}
	UART_printf("\r\n");
	//AES128
	resAES = AES_CFB(AES128bKey, AES_IV, gPlainDataBuff, gCryptoResultBuff, randomLen, AES_MODE_128_KEY_ENCRYPT);
	if(memcmp(AES128_0_ENCRYPT,  gCryptoResultBuff, randomLen))		//	AES128 CFB encrypt failed
	{
		UART_printf("AES128_0_ENCRYPT ERROR[%04X]\r\n", resAES);
		return;
	}
	UART_printf("AES128_0_ENCRYPT OK[%04X]\r\n", resAES);
	
	resAES = AES_CFB(AES128bKey, AES_IV, AES128_0_ENCRYPT, gCryptoResultBuff, randomLen, AES_MODE_128_KEY_DECRYPT);
	if(memcmp(gPlainDataBuff,  gCryptoResultBuff, randomLen))		//	AES128 CFB decrypt failed
	{
		UART_printf("AES128_0_DECRYPT ERROR[%04X]\r\n", resAES);
		return;
	}
	UART_printf("AES128_0_DECRYPT OK[%04X]\r\n", resAES);

	//AES192
	resAES = AES_CFB(AES192bKey, AES_IV, gPlainDataBuff, gCryptoResultBuff, randomLen, AES_MODE_192_KEY_ENCRYPT);
	if(memcmp(AES192_0_ENCRYPT,  gCryptoResultBuff, randomLen))		//	AES192 CFB encrypt failed
	{
		UART_printf("AES192_0_ENCRYPT ERROR[%04X]\r\n", resAES);
		return;
	}
	UART_printf("AES192_0_ENCRYPT OK[%04X]\r\n", resAES);
	
	resAES = AES_CFB(AES192bKey, AES_IV, AES192_0_ENCRYPT, gCryptoResultBuff, randomLen, AES_MODE_192_KEY_DECRYPT);
	if(memcmp(gPlainDataBuff,  gCryptoResultBuff, randomLen))		//	AES192 CFB decrypt failed
	{
		UART_printf("AES192_0_DECRYPT ERROR[%04X]\r\n", resAES);
		return;
	}
	UART_printf("AES192_0_DECRYPT OK[%04X]\r\n", resAES);

	//AES256
	resAES = AES_CFB(AES256bKey, AES_IV, gPlainDataBuff, gCryptoResultBuff, randomLen, AES_MODE_256_KEY_ENCRYPT);
	if(memcmp(AES256_0_ENCRYPT,  gCryptoResultBuff, randomLen))		//	AES256 CFB encrypt failed
	{
		UART_printf("AES256_0_ENCRYPT ERROR[%04X]\r\n", resAES);
		return;
	}
	UART_printf("AES256_0_ENCRYPT OK[%04X]\r\n", resAES);
	
	resAES = AES_CFB(AES256bKey, AES_IV, AES256_0_ENCRYPT, gCryptoResultBuff, randomLen, AES_MODE_256_KEY_DECRYPT);
	if(memcmp(gPlainDataBuff,  gCryptoResultBuff, randomLen))		//	AES256 CFB decrypt failed
	{
		UART_printf("AES256_0_DECRYPT ERROR[%04X]\r\n", resAES);
		return;
	}
	UART_printf("AES256_0_DECRYPT OK[%04X]\r\n", resAES);
	
	TMC_Delay(3000);
}

/**
    * @brief AES_ECB_Demo_Test:
                1.Encryption in 128-bit ECB mode
                2.Decryption in 128-bit ECB mode
                3.Encryption in 192-bit ECB mode
                4.Decryption in 192-bit ECB mode
                5.Encryption in 256-bit ECB mode
                6.Decryption in 256-bit ECB mode
    * @param  None
    * @retval None
 */
void AES_ECB_Demo_Test(void)
{
	bool result;

	/* AES-ECB-ENCRYPT: 128 bit */
	AES_ECB((unsigned char *)AES128bKey, (unsigned char *)AES128bPlainData, (unsigned char *)gCryptoResultBuff,
			AES_MODE_128_KEY_ENCRYPT);

	result = TMC_Compare(gCryptoResultBuff, (unsigned char *)AES128bEncData, AES_CRYPT_DATA_LEN);
	if (result == FALSE)
	{
		while(1);
	}

	/* AES-ECB-DECRYPT: 128 bit */
	AES_ECB((unsigned char *)AES128bKey, (unsigned char *)AES128bEncData, (unsigned char *)gCryptoResultBuff,
			AES_MODE_128_KEY_DECRYPT);

	result = TMC_Compare(gCryptoResultBuff, (unsigned char *)AES128bPlainData, AES_CRYPT_DATA_LEN);
	if (result == FALSE)
	{
		while(1);
	}

	/* AES-ECB-ENCRYPT: 192 bit */
	AES_ECB((unsigned char *)AES192bKey, (unsigned char *)AES192bPlainData, (unsigned char *)gCryptoResultBuff,
			AES_MODE_192_KEY_ENCRYPT);

	result = TMC_Compare(gCryptoResultBuff, (unsigned char *)AES192bEncData, AES_CRYPT_DATA_LEN);
	if (result == FALSE)
	{
		while(1);
	}

	/* AES-ECB-DECRYPT: 192 bit */
	AES_ECB((unsigned char *)AES192bKey, (unsigned char *)AES192bEncData, (unsigned char *)gCryptoResultBuff,
			AES_MODE_192_KEY_DECRYPT);

	result = TMC_Compare(gCryptoResultBuff, (unsigned char *)AES192bPlainData, AES_CRYPT_DATA_LEN);
	if (result == FALSE)
	{
		while(1);
	}

	/* AES-ECB-ENCRYPT: 256 bit */
	AES_ECB((unsigned char *)AES256bKey, (unsigned char *)AES256bPlainData, (unsigned char *)gCryptoResultBuff,
			AES_MODE_256_KEY_ENCRYPT);

	result = TMC_Compare(gCryptoResultBuff, (unsigned char *)AES256bEncData, AES_CRYPT_DATA_LEN);
	if (result == FALSE)
	{
		while(1);
	}

	/* AES-ECB-DECRYPT: 256 bit */
	AES_ECB((unsigned char *)AES256bKey, (unsigned char *)AES256bEncData, (unsigned char *)gCryptoResultBuff,
			AES_MODE_256_KEY_DECRYPT);

	result = TMC_Compare(gCryptoResultBuff, (unsigned char *)AES256bPlainData, AES_CRYPT_DATA_LEN);
	if (result == FALSE)
	{
		while(1);
	}
}
/************************** XDES_ECB Encrypt & Decrypt **********************/
/* ECB data */
__align(4) const unsigned char XDESKey[8]		 = {0x53, 0x6C, 0x33, 0x85, 0xC7, 0x43, 0xD7, 0x45};
__align(4) const unsigned char XDESPlainData[8]   = {0x4D, 0x1D, 0x32, 0x09, 0x5B, 0x31, 0x51, 0x23};
__align(4) const unsigned char XDESEncData[8]	 = {0x57, 0x2D, 0xB4, 0xF0, 0x6E, 0x72, 0xC6, 0x22};

__align(4) const unsigned char XDES2Key[16]	   = {
0x4A,0x1B,0xC7,0x73,0x15,0x25,0x55,0x8B,
0x7D,0x5E,0xA6,0x52,0xE2,0xBC,0x29,0xDD
};//{0x43, 0x65, 0xE1, 0x61, 0xE7, 0xF6, 0x79, 0x32, 0xA2, 0x31, 0xF2, 0xDF, 0x99, 0x00, 0x41, 0x4A};
__align(4) const unsigned char XDES2PlainData[8]  = {0x67,0x78,0xF0,0x3F,0x1A,0xC4,0x88,0x1C};
	//{0x00, 0x37, 0x47, 0x68, 0x58, 0x98, 0x5E, 0x24};
__align(4) const unsigned char XDES2EncData[8]	= {0x25, 0xA6, 0x7A, 0xC2, 0x94, 0xDB, 0x1F, 0x0A};
	//{0x7D, 0x51, 0x10, 0x1F, 0x14, 0x58, 0x6A, 0x04};

__align(4) const unsigned char XDES3Key[24]	   = {0xEA, 0xCF, 0x55, 0x22, 0xC1, 0xCD, 0x35, 0x1B, 0x7A, 0xD2, 0x99, 0x7C, 0x78, 0x28, 0x4D, 0x3D, 0xA0, 0x99, 0x0F, 0xA2, 0xB6, 0x6D, 0x32, 0x28};
__align(4) const unsigned char XDES3PlainData[8] = {0xC6, 0x72, 0xFE, 0xAB, 0x4C, 0x85, 0x0E, 0x13};
__align(4) const unsigned char XDES3EncData[8]	= {0xE2, 0xD9, 0xBD, 0xA0, 0xF1, 0x22, 0x7A, 0x36};


/* DES test------------------------------------------------------------------------------------------------------ */
/* ECB mode------------------------------------------------------------------------------------------ */
/* Des encrypt */
__align(4)	uint8_t const DesEcbEncKey[][8] = {	{0x53,0x6C,0x33,0x85,0xC7,0x43,0xD7,0x45},			
												{0x00,0x00,0x00,0x00,0x00,0x00,0x00,0x00},
												{0x21,0xD2,0x5E,0x04,0x35,0xB6,0x44,0x12},
												{0x53,0x6C,0x33,0x85,0xC7,0x43,0xD7,0x45},
												{0x8D,0x98,0x05,0x7B,0xBF,0xF2,0x4E,0xAF}};
__align(4)	uint8_t const DesEcbEncData[][8] = {  {0x96,0x8F,0x3D,0x75,0x4B,0xE0,0x82,0x4A},	
												  {0x00,0x00,0x00,0x00,0x00,0x00,0x00,0x00},
												  {0xE2,0xB0,0x22,0x06,0x87,0xD3,0x9B,0x51},
												  {0x96,0x8F,0x3D,0x75,0x4B,0xE0,0x82,0x4A},
												  {0x7B,0xBC,0x9E,0x15,0x70,0x23,0x8A,0x36}};
__align(4)	uint8_t const DesEcbEncCheckData[][8] = { {0x4D,0x1D,0x32,0x09,0x5B,0x31,0x51,0x23},	
													  {0x8C,0xA6,0x4D,0xE9,0xC1,0xB1,0x23,0xA7}, 
													  {0x85,0xD6,0x87,0xCB,0x77,0x36,0xD2,0xB4},
													  {0x4D,0x1D,0x32,0x09,0x5B,0x31,0x51,0x23},
													  {0xAA,0x94,0x73,0xBA,0x4D,0xBE,0xE3,0xE7}};
/* Des decrypt */
__align(4)	uint8_t const DesEcbDecKey[][8] = {{0x53,0x6C,0x33,0x85,0xC7,0x43,0xD7,0x45}, 
											   {0x8C,0xA6,0x4D,0xE9,0xC1,0xB1,0x23,0xA7},
											   {0x21,0xD2,0x5E,0x04,0x35,0xB6,0x44,0x12},
											   {0x53,0x6C,0x33,0x85,0xC7,0x43,0xD7,0x45},
											   {0x8D,0x98,0x05,0x7B,0xBF,0xF2,0x4E,0xAF}};
__align(4)	uint8_t const DesEcbDecData[][8] = {{0x4D,0x1D,0x32,0x09,0x5B,0x31,0x51,0x23},
												{0x04,0x94,0xF8,0x97,0x08,0x87,0x1D,0x3F},
												{0x85,0xD6,0x87,0xCB,0x77,0x36,0xD2,0xB4},
												{0x4D,0x1D,0x32,0x09,0x5B,0x31,0x51,0x23},
												{0xAA,0x94,0x73,0xBA,0x4D,0xBE,0xE3,0xE7}};
__align(4)	uint8_t const DesEcbDecCheckData[][8] = {{0x96,0x8F,0x3D,0x75,0x4B,0xE0,0x82,0x4A},
													 {0x00,0x00,0x00,0x00,0x00,0x00,0x00,0x00},
													 {0xE2,0xB0,0x22,0x06,0x87,0xD3,0x9B,0x51},
													 {0x96,0x8F,0x3D,0x75,0x4B,0xE0,0x82,0x4A},
													 {0x7B,0xBC,0x9E,0x15,0x70,0x23,0x8A,0x36}};
/* Tdes endcypt */
__align(4)	uint8_t const TDesEcbEncKey[][16] = {{0x43,0x65,0xE1,0x61,0xE7,0xF6,0x79,0x32,0xA2,0x31,0xF2,0xDF,0x99,0x00,0x41,0x4A},
												 {0xA0,0x99,0x0F,0xA2,0xB6,0x6D,0x32,0x28,0xEA,0xCF,0x55,0x22,0xC1,0xCD,0x35,0x1B},
												 {0x51,0x84,0x63,0xA3,0x2C,0xD5,0xA3,0x34,0x05,0xE6,0x8E,0xDC,0xB6,0x3E,0xA5,0x03},
												 {0x9D,0x4C,0xA9,0xB7,0xA3,0x12,0x35,0xC2,0xB1,0x33,0x25,0xAF,0xEA,0x7A,0x64,0x4B}};
__align(4)	uint8_t const TDesEcbEncData[][8] = {{0x00,0x37,0x47,0x68,0x58,0x98,0x5E,0x24},
												 {0xDC,0x2C,0x44,0x42,0x18,0x49,0x01,0x05},
												 {0x19,0x0A,0xC9,0x9D,0xA4,0x8E,0x0E,0x64},
										  		 {0xE3,0x55,0xAC,0x70,0x44,0x41,0xF2,0x52}};
__align(4)	uint8_t const TDesEcbEncCheckData[][8] = {{0x7D,0x51,0x10,0x1F,0x14,0x58,0x6A,0x04},
													  {0x7A,0xD2,0x99,0x7C,0x78,0x28,0x4D,0x3D},
													  {0x50,0xA2,0xB3,0x4A,0x41,0xE0,0x5D,0x1C},
										  			  {0x3D,0xB4,0x1F,0x7F,0x2B,0x8F,0xDB,0x66}};
/* Tdes Decrypt */
__align(4)	uint8_t const TDesEcbDecKey[][16] = {{0x43,0x65,0xE1,0x61,0xE7,0xF6,0x79,0x32,0xA2,0x31,0xF2,0xDF,0x99,0x00,0x41,0x4A},
												 {0x51,0x84,0x63,0xA3,0x2C,0xD5,0xA3,0x34,0x05,0xE6,0x8E,0xDC,0xB6,0x3E,0xA5,0x03},
												 {0x9D,0x4C,0xA9,0xB7,0xA3,0x12,0x35,0xC2,0xB1,0x33,0x25,0xAF,0xEA,0x7A,0x64,0x4B}};
__align(4)	uint8_t const TDesEcbDecData[][8] = {{0x7D,0x51,0x10,0x1F,0x14,0x58,0x6A,0x04},
												 {0x50,0xA2,0xB3,0x4A,0x41,0xE0,0x5D,0x1C},
												 {0x3D,0xB4,0x1F,0x7F,0x2B,0x8F,0xDB,0x66}};
__align(4)	uint8_t const TDesEcbDecCheckData[][8] = {{0x00,0x37,0x47,0x68,0x58,0x98,0x5E,0x24},
													  {0x19,0x0A,0xC9,0x9D,0xA4,0x8E,0x0E,0x64},
													  {0xE3,0x55,0xAC,0x70,0x44,0x41,0xF2,0x52}};
/* Tdes withou key */
__align(4)	uint8_t const TDesEcbDecKeyDecReuse[16] = {0xEA,0xCF,0x55,0x22,0xC1,0xCD,0x35,0x1B,0x7A,0xD2,0x99,0x7C,0x78,0x28,0x4D,0x3D};
__align(4)	uint8_t const TDesEcbDecDecData[][8] = {{0xC6,0x72,0xFE,0xAB,0x4C,0x85,0x0E,0x13},
										  			{0xD4,0x59,0x68,0xF3,0x34,0x56,0x78,0xBC}};
__align(4)	uint8_t const TDesEcbDecDecCheckData[][8] = {{0xA0,0x99,0x0F,0xA2,0xB6,0x6D,0x32,0x28},
										  				 {0x9F,0x71,0x0E,0x83,0xE9,0xA4,0x94,0x46}};
/* CBC mode-------------------------------------------------------------------------------------------- */
__align(4)	uint8_t const DesCbcEncKey[16]={0xBB,0xB6,0x33,0x18,0x54,0x56,0x7B,0xa2};	
__align(4)	uint8_t const DesCbcEncIV[8] = {0xFE,0xA9,0x87,0x89,0xBC,0xDC,0xBD,0xEF}; 
__align(4)	uint8_t const DesCbcEncData[8] = {0x89,0xBC,0xDE,0xFF,0xED,0xCB,0xA9,0x87};
__align(4)	uint8_t const DesCbcEncCkeckData[8]={0xf7,0x9B,0x60,0x4a,0x04,0x62,0x10,0x63};
__align(4)	uint8_t const TDesCbcDecKey[16] = {0x11,0x22,0x33,0x44,0x55,0x66,0x77,0x88,0x98,0x76,0x54,0x32,0x98,0x76,0x54,0x32};	
__align(4)	uint8_t const TDesCbcDecIV[8] = {0x9C,0x8F,0x10,0x09,0x6B,0xF5,0x3B,0xD0}; 
__align(4)	uint8_t const TDesCbcDecData[8] = {0x83,0xC1,0x6B,0x68,0x26,0x38,0x19,0x9A};
__align(4)	uint8_t const TDesCbcDecCkeckData[8] = {0xEE,0xEE,0xEE,0xEE,0xEE,0xEE,0xEE,0xEE};
														 
#define SUCCESS	0
#define	IVDINS	2		//	Invalid INS,6D00
#define	P3ERROR	4		//	P3 error,6C00
#define	WRERROR	6		//	Flash write error,6501
#define	RDERROR	8		//	Verify error,6504
  
//__align(4) uint8_t	staticDataOut[0x100];

/**
    * @brief XDES_ECB_Demo_Test:
                1.Encryption in One KEY ECB mode
                2.Decryption in One KEY ECB mode
                3.Encryption in Two KEY ECB mode
                4.Decryption in Two KEY ECB mode
                5.Encryption in Three KEY ECB mode
                6.Decryption in Three KEY ECB mode
    * @param  None
    * @retval None
 */
void XDES_ECB_Demo_Test(void)
{
	bool result;
//	uint16_t dwAlgResult;

	/* XDES-ECB-ENCRYPT: One KEY */
	XDES_ECB((uint8_t *)XDESKey, (uint8_t *)XDESPlainData, gCryptoResultBuff, XDES_MODE_KEY_ENCRYPT);

	result = TMC_Compare(gCryptoResultBuff, (uint8_t *)XDESEncData, XDES_CRYPT_DATA_LEN);
	if (result == FALSE)
	{
		while(1);
	}

	/* XDES-ECB-DECRYPT: One KEY */
	XDES_ECB((uint8_t *)XDESKey, (uint8_t *)XDESEncData, gCryptoResultBuff, XDES_MODE_KEY_DECRYPT);

	result = TMC_Compare(gCryptoResultBuff, (uint8_t *)XDESPlainData, XDES_CRYPT_DATA_LEN);
	if (result == FALSE)
	{
		while(1);
	}

	/* XDES-ECB-ENCRYPT: Two KEY */
	XDES_ECB((uint8_t *)XDES2Key, (uint8_t *)XDES2PlainData, gCryptoResultBuff, XDES_MODE_2KEY_ENCRYPT);

	result = TMC_Compare(gCryptoResultBuff, (uint8_t *)XDES2EncData, XDES_CRYPT_DATA_LEN);
	if (result == FALSE)
	{
		while(1);
	}

	/* XDES-ECB-DECRYPT: Two KEY */
	XDES_ECB((uint8_t *)XDES2Key, (uint8_t *)XDES2EncData, gCryptoResultBuff, XDES_MODE_2KEY_DECRYPT);

	result = TMC_Compare(gCryptoResultBuff, (uint8_t *)XDES2PlainData, XDES_CRYPT_DATA_LEN);
	if (result == FALSE)
	{
		while(1);
	}

	/* XDES-ECB-ENCRYPT: Three KEY */
	XDES_ECB((uint8_t *)XDES3Key, (uint8_t *)XDES3PlainData, gCryptoResultBuff, XDES_MODE_3KEY_ENCRYPT);

	result = TMC_Compare(gCryptoResultBuff, (uint8_t *)XDES3EncData, XDES_CRYPT_DATA_LEN);
	if (result == FALSE)
	{
		while(1);
	}

	/* XDES-ECB-DECRYPT: Three KEY */
	XDES_ECB((uint8_t *)XDES3Key, (uint8_t *)XDES3EncData, gCryptoResultBuff, XDES_MODE_3KEY_DECRYPT);

	result = TMC_Compare(gCryptoResultBuff, (uint8_t *)XDES3PlainData, XDES_CRYPT_DATA_LEN);
	if (result == FALSE)
	{
		while(1);
	}
}
/************************** RSA Encrypt & Decrypt **********************/

/* RSA KEY */
//RSA_KEY_BIT_LEN: Max is 4096
#define RSA_KEY_BIT_LEN	 4096
#define RSA_KEY_LEN		 (RSA_KEY_BIT_LEN >> 3)
#define RSA_CRT_KEY_LEN	 (RSA_KEY_LEN >> 1)
#define RSA_KEY_E_LEN	   0x04
#define RSA_PLAIN_DATA_LEN  0x10

unsigned char RSA_KEY_E[4]   = {0x00, 0x01, 0x00, 0x01};
unsigned char RSA_KEY_D[RSA_KEY_LEN];
unsigned char RSA_KEY_N[RSA_KEY_LEN];
unsigned char RSA_CRT_KEY_P[RSA_CRT_KEY_LEN] __attribute__((at(0x21003100)));
unsigned char RSA_CRT_KEY_Q[RSA_CRT_KEY_LEN] __attribute__((at(0x21003100 + RSA_CRT_KEY_LEN)));
unsigned char RSA_CRT_KEY_DP[RSA_CRT_KEY_LEN] __attribute__((at(0x21003100 + 2*RSA_CRT_KEY_LEN)));
unsigned char RSA_CRT_KEY_DQ[RSA_CRT_KEY_LEN] __attribute__((at(0x21003100 + 3*RSA_CRT_KEY_LEN)));;
unsigned char RSA_CRT_KEY_QINV[RSA_CRT_KEY_LEN] __attribute__((at(0x21003100 + 4*RSA_CRT_KEY_LEN)));

unsigned char RSAPlainData[RSA_PLAIN_DATA_LEN] = {0x00, 0x01, 0x02, 0x03, 0x00, 0x01, 0x02, 0x03, 0x00, 0x01, 0x02, 0x03, 0x00, 0x01, 0x02, 0x03};
unsigned char RSAEncData[RSA_KEY_LEN];

/**
    * @brief RSA_Demo_Test:
                1.Generate key pair
                2.Save CRT parameters
                3.Encryption
                4.Decryption
                5.Decryption-CRT
    * @param  None
    * @retval None
 */
void RSA_Demo_Test(void)
{
	BigNum_t inputBuf, outputBuf;

	RSAPrivKey_t RSA_PrivKey;
	RSAPubKey_t RSA_PubKey;
	RSAPrivKeyCrt_t RSA_PrivKeyCrt;
	RSAKeyGenOut_t rsaGenOut;
	//RSAKGOut_t rsaGenOut;
	unsigned short sCryptResult = PKE_ALG_OK;
	unsigned char result = 0x00;
	unsigned char bGenKeyMode = 0x00;

	/* GenerateKeyPair */
	RSA_PubKey.E.p = RSA_KEY_E;
	RSA_PubKey.E.length = RSA_KEY_E_LEN;
	bGenKeyMode = RSA_GEN_KEY_MODE_MSB_BIT_1 |
				  RSA_GEN_KEY_MODE_VERIFY;//Verify the Key,the most significant bit must be 1.
	sCryptResult = tmcRSAKeyPairGen(&rsaGenOut, &RSA_PubKey.E, RSA_KEY_BIT_LEN, bGenKeyMode);
	if(PKE_ALG_OK != sCryptResult)
	{
		result = 0x1;
		goto END;
	}
	else
	{
		//save Key.
		memcpy(RSA_KEY_N, rsaGenOut.PriKey.N.p, RSA_KEY_LEN);
		memcpy(RSA_KEY_D, rsaGenOut.PriKey.D.p, RSA_KEY_LEN);
		memcpy(RSA_CRT_KEY_P, rsaGenOut.PriCrtKey.P.p, RSA_CRT_KEY_LEN);
		memcpy(RSA_CRT_KEY_Q, rsaGenOut.PriCrtKey.Q.p, RSA_CRT_KEY_LEN);
		memcpy(RSA_CRT_KEY_DP, rsaGenOut.PriCrtKey.DP.p, RSA_CRT_KEY_LEN);
		memcpy(RSA_CRT_KEY_DQ, rsaGenOut.PriCrtKey.DQ.p, RSA_CRT_KEY_LEN);
		memcpy(RSA_CRT_KEY_QINV, rsaGenOut.PriCrtKey.QInv.p, RSA_CRT_KEY_LEN);
	}

	/* RSA-Encrypt */
	RSA_PubKey.N.p = RSA_KEY_N;
	RSA_PubKey.N.length = RSA_KEY_LEN;

	inputBuf.p = RSAPlainData;
	inputBuf.length = RSA_PLAIN_DATA_LEN;
	outputBuf.p = RSAEncData;
	sCryptResult = tmcRSAEncrypt(&outputBuf, &inputBuf, &RSA_PubKey);
	if(PKE_ALG_OK != sCryptResult)
	{
		result = 2;
		goto END;
	}

	/* RSA-Decrypt */
	RSA_PrivKey.N.p = RSA_KEY_N;
	RSA_PrivKey.N.length = RSA_KEY_LEN;

	RSA_PrivKey.D.p = RSA_KEY_D;
	RSA_PrivKey.D.length = RSA_KEY_LEN;
	inputBuf.p = RSAEncData;
	inputBuf.length = RSA_KEY_LEN;
	outputBuf.p = gCryptoResultBuff;
	sCryptResult = tmcRSADecrypt(&outputBuf, &inputBuf, &RSA_PrivKey);
	if(PKE_ALG_OK != sCryptResult)
	{
		result = 3;
		goto END;
	}
	//check decrypt result
	if (RSA_PLAIN_DATA_LEN < RSA_KEY_LEN)
	{
		//If the length of plain data less than the length of Key,padding zero in front.
		if (FALSE == TMC_Compare(gCryptoResultBuff + (RSA_KEY_LEN - RSA_PLAIN_DATA_LEN), RSAPlainData,
								 RSA_PLAIN_DATA_LEN))
		{
			result = 4;
			goto END;
		}
	}
	else
	{
		if (FALSE == TMC_Compare(gCryptoResultBuff, RSAPlainData, RSA_PLAIN_DATA_LEN))
		{
			result = 5;
			goto END;
		}
	}

	/* RSA-CRT Decypt */
	RSA_PrivKeyCrt.P.p = RSA_CRT_KEY_P;
	RSA_PrivKeyCrt.P.length = RSA_CRT_KEY_LEN;
	RSA_PrivKeyCrt.Q.p = RSA_CRT_KEY_Q;
	RSA_PrivKeyCrt.Q.length = RSA_CRT_KEY_LEN;
	RSA_PrivKeyCrt.DP.p = RSA_CRT_KEY_DP;
	RSA_PrivKeyCrt.DP.length = RSA_CRT_KEY_LEN;
	RSA_PrivKeyCrt.DQ.p = RSA_CRT_KEY_DQ;
	RSA_PrivKeyCrt.DQ.length = RSA_CRT_KEY_LEN;
	RSA_PrivKeyCrt.QInv.p = RSA_CRT_KEY_QINV;
	RSA_PrivKeyCrt.QInv.length = RSA_CRT_KEY_LEN;
	inputBuf.p = RSAEncData;
	inputBuf.length = RSA_KEY_LEN;
	outputBuf.p = gCryptoResultBuff;
	sCryptResult = tmcRSADecryptCrt_SU(&outputBuf, &inputBuf, &RSA_PrivKeyCrt, &(RSA_PubKey.E));
	if(PKE_ALG_OK != sCryptResult)
	{
		result = 6;
		goto END;
	}
	//check decrypt result
	if (RSA_PLAIN_DATA_LEN < RSA_KEY_LEN)
	{
		//If the length of plain data less than the length of Key,padding zero in front.
		if (FALSE == TMC_Compare(gCryptoResultBuff + (RSA_KEY_LEN - RSA_PLAIN_DATA_LEN), RSAPlainData,
								 RSA_PLAIN_DATA_LEN))
		{
			result = 7;
		}
	}
	else
	{
		if (FALSE == TMC_Compare(gCryptoResultBuff, RSAPlainData, RSA_PLAIN_DATA_LEN))
		{
			result = 8;
		}
	}
END:
	if (result != 0x0)
	{
		while(1);
	}
}

/************************** ECC Encrypt & Decrypt **********************/
#define ECC_P1LAIN_DATA_LEN  0x10
unsigned char ECC_P1UB_KEY[0x40] __attribute__((at(0x21003060)));
unsigned char ECC_P1RIV_KEY[0x20] __attribute__((at(0x210030A0)));

unsigned char ECC_DOMAIN_P[0x20]  = {0xFF, 0xFF, 0xFF, 0xFF, 0x00, 0x00, 0x00, 0x01, 0x00, 0x00, 0x00, 0x00, 0x00, 0x00, 0x00, 0x00, 0x00, 0x00, 0x00, 0x00, 0xFF, 0xFF, 0xFF, 0xFF, 0xFF, 0xFF, 0xFF, 0xFF, 0xFF, 0xFF, 0xFF, 0xFF};
unsigned char ECC_DOMAIN_A[0x20]  = {0xFF, 0xFF, 0xFF, 0xFF, 0x00, 0x00, 0x00, 0x01, 0x00, 0x00, 0x00, 0x00, 0x00, 0x00, 0x00, 0x00, 0x00, 0x00, 0x00, 0x00, 0xFF, 0xFF, 0xFF, 0xFF, 0xFF, 0xFF, 0xFF, 0xFF, 0xFF, 0xFF, 0xFF, 0xFC};
unsigned char ECC_DOMAIN_B[0x20]  = {0x5A, 0xC6, 0x35, 0xD8, 0xAA, 0x3A, 0x93, 0xE7, 0xB3, 0xEB, 0xBD, 0x55, 0x76, 0x98, 0x86, 0xBC, 0x65, 0x1D, 0x06, 0xB0, 0xCC, 0x53, 0xB0, 0xF6, 0x3B, 0xCE, 0x3C, 0x3E, 0x27, 0xD2, 0x60, 0x4B};
unsigned char ECC_DOMAIN_Gx[0x20] = {0x6B, 0x17, 0xD1, 0xF2, 0xE1, 0x2C, 0x42, 0x47, 0xF8, 0xBC, 0xE6, 0xE5, 0x63, 0xA4, 0x40, 0xF2, 0x77, 0x03, 0x7D, 0x81, 0x2D, 0xEB, 0x33, 0xA0, 0xF4, 0xA1, 0x39, 0x45, 0xD8, 0x98, 0xC2, 0x96};
unsigned char ECC_DOMAIN_Gy[0x20] = {0x4F, 0xE3, 0x42, 0xE2, 0xFE, 0x1A, 0x7F, 0x9B, 0x8E, 0xE7, 0xEB, 0x4A, 0x7C, 0x0F, 0x9E, 0x16, 0x2B, 0xCE, 0x33, 0x57, 0x6B, 0x31, 0x5E, 0xCE, 0xCB, 0xB6, 0x40, 0x68, 0x37, 0xBF, 0x51, 0xF5};
unsigned char ECC_DOMAIN_N[0x20]  = {0xFF, 0xFF, 0xFF, 0xFF, 0x00, 0x00, 0x00, 0x00, 0xFF, 0xFF, 0xFF, 0xFF, 0xFF, 0xFF, 0xFF, 0xFF, 0xBC, 0xE6, 0xFA, 0xAD, 0xA7, 0x17, 0x9E, 0x84, 0xF3, 0xB9, 0xCA, 0xC2, 0xFC, 0x63, 0x25, 0x51};

unsigned char EccPrivKey[32] = {0x30, 0xC8, 0x8C, 0xE0, 0xCC, 0x32, 0x23, 0x38,
                                0xB3, 0x0C, 0x88, 0xCE, 0x5A, 0xCC, 0x32, 0x23,
                                0x58, 0x5B, 0x4E, 0xDC, 0x18, 0xD9, 0xF3, 0x02,
                                0x57, 0xCC, 0x22, 0x67, 0xD1, 0x73, 0xB1, 0x22};


unsigned char EccPubKey[64] = {0xF2, 0x0B, 0x86, 0xD2, 0x99, 0xB9, 0x97, 0xD6,
                                0x49, 0x53, 0x27, 0x26, 0xCB, 0x09, 0x8A, 0x19,
                                0x7B, 0x23, 0x90, 0x29, 0x84, 0xB4, 0x54, 0x60,
                                0xD1, 0xC6, 0xFC, 0x56, 0x58, 0x72, 0x2A, 0x7F,
                                0x04, 0x24, 0x6D, 0x45, 0xF1, 0xA1, 0xBF, 0xAD,
                                0x02, 0x0D, 0x21, 0xEA, 0x02, 0xF0, 0xFB, 0x51,
                                0x65, 0x19, 0x9E, 0x56, 0x48, 0x06, 0x12, 0x44,
                                0x4A, 0xE1, 0x40, 0x22, 0x0A, 0xBC, 0x67, 0xD6};

unsigned char Plain[64] = {0x30, 0x46, 0xCC, 0x78, 0x58, 0x37, 0x3C, 0xA0,
                                0xC5, 0xD2, 0x78, 0x87, 0x2F, 0xAC, 0x2B, 0xDB,
                                0x97, 0x84, 0x0B, 0x5B, 0xCA, 0x25, 0xE1, 0xC2,
                                0x2A, 0x97, 0x84, 0x0B, 0xAB, 0x5C, 0x12, 0x2E,
                                0x4A, 0x89, 0x4E, 0x65, 0xA9, 0x52, 0xA2, 0x53,
                                0xA4, 0x4A, 0x89, 0x4E, 0x91, 0x2A, 0x25, 0x3A,
                                0x81, 0x7B, 0xEF, 0x69, 0x47, 0xE0, 0xDE, 0x7B,
                                0x1D, 0x81, 0x7B, 0xEF, 0x76, 0x04, 0xEE, 0xBD};

unsigned char Cipher[160] = {0xBD, 0xEC, 0x3A, 0x2E, 0x8F, 0x41, 0x68, 0x06,
                                    0x65, 0x9B, 0x6D, 0xE5, 0xAD, 0x75, 0xB5, 0x33,
                                    0xCD, 0x62, 0x1F, 0x27, 0x4F, 0xC9, 0xA5, 0xE7,
                                    0x1B, 0x48, 0x0B, 0xDF, 0xFE, 0x3A, 0x4D, 0xDE,
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                                    0xAA, 0x06, 0xA3, 0x9B, 0x02, 0xD9, 0x47, 0xEE};

BigNum_t ECC_P1ubKey1  = {ECC_P1UB_KEY, 0x40};
BigNum_t ECC_P1rivKey1 = {ECC_P1RIV_KEY, 0x20};
BigNum_t ECC_P1	   = {ECC_DOMAIN_P, 0x20};
BigNum_t ECC_N1	   = {ECC_DOMAIN_N, 0x20};
BigNum_t ECC_A1	   = {ECC_DOMAIN_A, 0x20};
BigNum_t ECC_B1	   = {ECC_DOMAIN_B, 0x20};
BigNum_t ECC_Gx1	  = {ECC_DOMAIN_Gx, 0x20};
BigNum_t ECC_Gy1	  = {ECC_DOMAIN_Gy, 0x20};

BigNum_t Plain_BigNum = {Plain, 64};
BigNum_t Cipher_BigNum = {Cipher, 160};

ECC_Domain_t ECC_DOMAIN1 = {&ECC_P1, &ECC_N1, &ECC_A1, &ECC_B1, &ECC_Gx1, &ECC_Gy1};

unsigned char ECCPlainData[ECC_P1LAIN_DATA_LEN] = {0x00, 0x01, 0x02, 0x03, 0x00, 0x01, 0x02, 0x03, 0x00, 0x01, 0x02, 0x03, 0x00, 0x01, 0x02, 0x03};
unsigned char ECCEncData[0x40];
unsigned char CipherBuf[160];
unsigned char PlainBuf[64];

BigNum_t Share1 = {NULL, 0}, Share2 = {NULL, 0};


/**
    * @brief ECC_Demo_Test:
                1.Check whether the curve parameters are valid
                2.Generate key pair
                3.ECC sign
                4.ECC verify
    * @param  None
    * @retval None
 */
void ECC_Demo_Test(void)
{
    BigNum_t inputBuf, outputBuf, PlainTemp, CipherTemp;
    unsigned short sCryptResult = PKE_ALG_OK;
    unsigned char result = 0x00, pucMask[8] = {0};
    
    /* Check ECC Parameter */
    sCryptResult = tmcECCParamCheck(&ECC_DOMAIN1);
    if (PKE_ALG_OK != sCryptResult)
    {
        result = 0x01;
        goto END;
    }
    
    /* ECC GenerateKeyPair */
    sCryptResult = tmcECCKeyGen(&ECC_P1ubKey1, &ECC_P1rivKey1, &ECC_DOMAIN1, ECC_GEN_KEY_MODE_GEN_PRI_KEY);
    if (PKE_ALG_OK != sCryptResult)
    {
        result = 0x02;
        goto END;
    }
    
    /* ECC Sign */
    inputBuf.p = ECCPlainData;
    inputBuf.length = ECC_P1LAIN_DATA_LEN;
    outputBuf.p = ECCEncData;
    outputBuf.length = 0x40;
    sCryptResult = tmcECCSign(&outputBuf, &inputBuf, &ECC_P1rivKey1, &ECC_DOMAIN1) ;
    if (PKE_ALG_OK != sCryptResult)
    {
        result = 0x03;
        goto END;
    }
    
    /* ECC Verify */
    sCryptResult = tmcECCVerify(&inputBuf, &ECC_P1ubKey1, &outputBuf, &ECC_DOMAIN1);
    if (PKE_ALG_OK != sCryptResult)
    {
        result = 0x04;
        goto END;
    }
    
    /* ECC Check point is on the curve */
    /* The public key is on the curve */
    sCryptResult = tmcECCPtChk(&ECC_P1ubKey1, &ECC_DOMAIN1);
    if (PKE_ALG_OK != sCryptResult)
    {
        result = 0x05;
        goto END;
    }
    
    /* The plain is not on the curve */
    sCryptResult = tmcECCPtChk(&Plain_BigNum, &ECC_DOMAIN1);
    
    memcpy(ECC_P1RIV_KEY, EccPrivKey,0x20);
    memcpy(ECC_P1UB_KEY, EccPubKey,0x40);
    /* ECC Encrypt */
    CipherTemp.p = CipherBuf;
    sCryptResult = tmcECCEncrypt(&CipherTemp, &Plain_BigNum, &ECC_P1ubKey1, &Share1, &Share2, &ECC_DOMAIN1, 0);
    if (PKE_ALG_OK != sCryptResult)
    {
        result = 0x06;
        goto END;
    }
    
    /* ECC Decrypt */
    PlainTemp.p = PlainBuf; 
    sCryptResult = tmcECCDecrypt(&PlainTemp, &CipherTemp, &ECC_P1rivKey1, &Share1, &Share2, pucMask, &ECC_DOMAIN1, 0);
    if (PKE_ALG_OK != sCryptResult)
    {
        result = 0x07;
        goto END;
    }
    /* Check data calculation is correct */
    if (memcmp(PlainBuf, Plain, 64))
    {
        result = 0x08;
        goto END;
    }
    
    memset(PlainBuf, 0, 64);
    
    PlainTemp.p = PlainBuf;
    sCryptResult = tmcECCDecrypt(&PlainTemp, &Cipher_BigNum, &ECC_P1rivKey1, &Share1, &Share1, pucMask, &ECC_DOMAIN1, 0);
    if (PKE_ALG_OK != sCryptResult)
    {
        result = 0x07;
        goto END;
    }
    /* Check data calculation is correct */
    if (memcmp(PlainBuf, Plain, 64))
    {
        result = 0x08;
        goto END;
    }

END:
	if (result != 0x0)
	{
		while(1);
	}
}

/************************** SHA1  **********************/
/* SHA1 data */
unsigned char const SHA1InputData[5] = {0x78, 0xAD, 0x18, 0xE7, 0x10};
unsigned char const SHA1CheckData[0x14] = {0x87, 0xac, 0xe6, 0xf2, 0xa6, 0x4b, 0x66, 0x98, 0x20, 0x76, 0x8f, 0x97, 0x1c, 0xf1, 0x7c, 0x06, 0xd9, 0x2d, 0xea, 0x8e};


/**
    * @brief SHA1_Demo_Test:
                1.Initialize SHA1_Context to 0 
                2.Input the data and length to be calculated
                3.Get summary data
                4.Compare whether it meets expectations
    * @param  None
    * @retval None
 */
void SHA1_Demo_Test(void)
{

	SHA1_Context_t SHA1_Context;
	tmcSHA1Init (&SHA1_Context);
	tmcSHA1Update(&SHA1_Context, SHA1InputData, sizeof(SHA1InputData));

	if(tmcSHA1Final(gCryptoResultBuff, &SHA1_Context) != PKE_ALG_OK)
	{
		while(1);
	}
	else
	{
		if (FALSE == TMC_Compare(gCryptoResultBuff, (unsigned char*)SHA1CheckData, sizeof(SHA1CheckData)))
		{
			while(1);
		}
	}
}
/************************** SHA256  **********************/
/* SHA256 data */
unsigned char const SHA256InputData[4] = {0xD3, 0x09, 0x9B, 0x4B};
unsigned char const SHA256CheckData[0x20] = {0x0d, 0xb6, 0x3a, 0x46, 0x4b, 0x76, 0x59, 0xa5, 0x2d, 0xb9, 0x82, 0x7f, 0xb5, 0x3c, 0x2e, 0xba, 0x61, 0x15, 0xc2, 0x76, 0x4e, 0xb8, 0x02, 0xde, 0x72, 0x14, 0x68, 0xb9, 0x96, 0xdb, 0x5c, 0x5c};


/**
    * @brief SHA256_Demo_Test:
                1.Initialize SHA256_Context to 0 
                2.Input the data and length to be calculated
                3.Get summary data
                4.Compare whether it meets expectations
    * @param  None
    * @retval None
 */
void SHA256_Demo_Test(void)
{

	SHA256_Context_t SHA256_Context;

	tmcSHA256Init (&SHA256_Context);
	tmcSHA256Update(&SHA256_Context, SHA256InputData, sizeof(SHA256InputData));
	if(tmcSHA256Final(gCryptoResultBuff, &SHA256_Context) != PKE_ALG_OK)
	{
		while(1);
	}
	else
	{
		if (FALSE == TMC_Compare(gCryptoResultBuff, (unsigned char*)SHA256CheckData, sizeof(SHA256CheckData)))
		{
			while(1);
		}
	}
}

/***************************************************************************
* Function: void CRYPTO_DemoMain(void)
* Description:   CRYPTO Demo
* Input:  NULL
* Output: NULL
* Return: NULL
* Other:  NULL
**************************************************************************/
void CRYPTO_DemoMain(void)
{
//    SHA1_Demo_Test();
//    SHA256_Demo_Test();
//    XDES_ECB_Demo_Test();
//    AES_ECB_Demo_Test();
//    ECC_Demo_Test();
//    RSA_Demo_Test();
//    UART_printf("Algorithm test pass!!!\r\n");
	AES_CFB_Demo_Test();
}

/************************ (C) COPYRIGHT TMC *****END OF FILE****/
